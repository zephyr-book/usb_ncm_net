/**
 * @file client.cpp
 * @brief Host EDHOC Initiator + OSCORE client for the ZBook usb_ncm_net
 *        suite-0 (X25519) build -- the peer counterpart of the device firmware,
 *        built from the SAME libraries (libedhoc for EDHOC, uoscore-uedhoc for
 *        OSCORE) so interop is guaranteed at the encoder level.
 *
 * Adapted from uoscore-uedhoc/samples/linux_edhoc_oscore/initiator_client: the
 * UDP socket + cantcoap transport + OSCORE loop are reused; the (buggy) uEDHOC
 * engine is replaced by libedhoc's synchronous suite-0 initiator, and the RFC
 * 9668 transport framing (0xf5 on message_1, C_R on message_3) is added.
 *
 * Flow: message_1_compose -> POST /.well-known/edhoc -> message_2_process ->
 * message_3_compose -> POST -> message_4_process -> export_oscore_session ->
 * oscore_context_init -> OSCORE-protected GET/PUT hello|led.
 *
 * Creds come from edhoc_creds_client.h (generated by scripts/edhoc_keys.py;
 * must match the flashed firmware's edhoc_creds.h).
 *
 * @copyright Copyright (c) 2026 Centro de Inovacao EDGE
 * SPDX-License-Identifier: Apache-2.0
 */

#include <stdint.h>
#include <stdio.h>
#include <stdlib.h>
#include <string.h>
#include <sys/socket.h>
#include <sys/time.h>
#include <time.h>
#include <unistd.h>

extern "C" {
#include "edhoc.h"		/* libedhoc */
#include "edhoc_cipher_suite_0.h"
#include "oscore.h"		/* uoscore-uedhoc, OSCORE half */
#include "sock.h"
}
#include <psa/crypto.h>

#include "cantcoap.h"
#include "edhoc_creds_client.h"

#include <algorithm>
#include <cmath>
#include <vector>

#define MSG_MAX	   256
#define OSCORE_MAX 512

static const char *g_host = "192.0.2.1";

/* Monotonic wall-clock in milliseconds (for latency timing). */
static double now_ms(void)
{
	struct timespec ts;
	clock_gettime(CLOCK_MONOTONIC, &ts);
	return (double)ts.tv_sec * 1e3 + (double)ts.tv_nsec / 1e6;
}

/* ---- EDHOC credential callbacks (Initiator role) ---- */

static int cred_fetch(void *user_ctx, struct edhoc_auth_creds *creds)
{
	(void)user_ctx;

	creds->label = EDHOC_COSE_HEADER_KID;
	creds->key_id.cred = ED_CRED_I;
	creds->key_id.cred_len = sizeof(ED_CRED_I);
	creds->key_id.cred_is_cbor = true;
	creds->key_id.encode_type = EDHOC_ENCODE_TYPE_BYTE_STRING;
	creds->key_id.key_id_bstr[0] = ED_KID_I;
	creds->key_id.key_id_bstr_length = 1;

	if (edhoc_cipher_suite_0_key_import(NULL, EDHOC_KT_KEY_AGREEMENT, ED_I_PRIV,
					    sizeof(ED_I_PRIV), creds->priv_key_id) != EDHOC_SUCCESS) {
		return EDHOC_ERROR_CREDENTIALS_FAILURE;
	}
	return EDHOC_SUCCESS;
}

static int cred_verify(void *user_ctx, struct edhoc_auth_creds *creds,
		       const uint8_t **public_key_reference, size_t *public_key_length)
{
	(void)user_ctx;

	if (creds->label != EDHOC_COSE_HEADER_KID) {
		return EDHOC_ERROR_CREDENTIALS_FAILURE;
	}

	/* Peer (responder/device) kid, transported as a compact CBOR int per
	 * RFC 9528 3.3.2 -- accept the byte-string form too. */
	if (creds->key_id.encode_type == EDHOC_ENCODE_TYPE_INTEGER) {
		if (creds->key_id.key_id_int != ED_KID_R_INT) {
			return EDHOC_ERROR_CREDENTIALS_FAILURE;
		}
	} else {
		if (creds->key_id.key_id_bstr_length != 1 ||
		    creds->key_id.key_id_bstr[0] != ED_KID_R) {
			return EDHOC_ERROR_CREDENTIALS_FAILURE;
		}
	}

	/* Rebuild ID_CRED_R as {4: h'<kid>'} for the MAC context. */
	creds->key_id.encode_type = EDHOC_ENCODE_TYPE_BYTE_STRING;
	creds->key_id.key_id_bstr[0] = ED_KID_R;
	creds->key_id.key_id_bstr_length = 1;
	creds->key_id.cred = ED_CRED_R;
	creds->key_id.cred_len = sizeof(ED_CRED_R);
	creds->key_id.cred_is_cbor = true;

	*public_key_reference = ED_G_R;
	*public_key_length = sizeof(ED_G_R);
	return EDHOC_SUCCESS;
}

/* ---- CoAP/UDP transport (cantcoap) ---- */

/* POST an EDHOC message to /.well-known/edhoc; return the 2.04 response payload
 * (message_2 or message_4) in resp. Returns 0 on success. */
static int edhoc_post(int sock, const uint8_t *payload, size_t len, uint8_t *resp,
		      size_t *resp_len)
{
	static uint16_t mid = 0;
	static uint32_t token = 0;
	CoapPDU pdu;
	pdu.setVersion(1);
	pdu.setType(CoapPDU::COAP_CONFIRMABLE);
	pdu.setCode(CoapPDU::COAP_POST);
	++token;
	pdu.setToken((uint8_t *)&token, sizeof(token));
	pdu.setMessageID(mid++);
	pdu.setURI((char *)".well-known/edhoc", 17);
	pdu.setPayload((uint8_t *)payload, len);

	if (send(sock, pdu.getPDUPointer(), pdu.getPDULength(), 0) < 0) {
		printf("send failed\n");
		return -1;
	}

	uint8_t buf[MAXLINE];
	int n = recv(sock, buf, sizeof(buf), 0);
	if (n < 0) {
		printf("recv failed / timeout\n");
		return -1;
	}

	CoapPDU rx(buf, n);
	if (!rx.validate()) {
		printf("invalid CoAP response (%d bytes)\n", n);
		return -1;
	}

	int c = rx.getCode();
	uint32_t pl = rx.getPayloadLength();
	printf("  <- CoAP %d.%02d, %u-byte payload\n", (c >> 5), (c & 0x1f), pl);
	if (pl == 0) {
		printf("  (empty payload: the device's EDHOC handler likely errored -- check UART)\n");
	}
	if (pl > *resp_len) {
		printf("response too large (%u)\n", pl);
		return -1;
	}
	memcpy(resp, rx.getPayloadPointer(), pl);
	*resp_len = pl;
	return 0;
}

/* ---- OSCORE-protected request ---- */

/* Perform one OSCORE-protected request/response. When @rtt_ms is non-NULL it is
 * set to the wire round-trip (just-before-send .. datagram-received) in ms --
 * the client-side coap2oscore encrypt is done before timing starts and the
 * oscore2coap decrypt after it stops, so the number reflects device+transport
 * cost (comparable to the plaintext/DTLS probe in scripts/coap_latency.py).
 * @quiet suppresses the per-request line so its synchronous stdout I/O does not
 * perturb the timing loop. */
static int oscore_request(int sock, struct context *osc, CoapPDU::Code code,
			  const char *uri, const uint8_t *payload, size_t payload_len,
			  double *rtt_ms = NULL, bool quiet = false)
{
	static uint16_t mid = 256;
	static uint32_t token = 0x1000;
	CoapPDU pdu;
	pdu.setVersion(1);
	pdu.setType(CoapPDU::COAP_CONFIRMABLE);
	pdu.setCode(code);
	++token;
	pdu.setToken((uint8_t *)&token, sizeof(token));
	pdu.setMessageID(mid++);
	pdu.setURI((char *)uri, strlen(uri));
	if (payload && payload_len) {
		pdu.setPayload((uint8_t *)payload, payload_len);
	}

	uint8_t oscore_buf[OSCORE_MAX];
	uint32_t oscore_len = sizeof(oscore_buf);
	enum err e = coap2oscore(pdu.getPDUPointer(), (uint32_t)pdu.getPDULength(), oscore_buf,
				 &oscore_len, osc);
	if (e != ok) {
		if (!quiet) {
			printf("coap2oscore failed (%d)\n", e);
		}
		return -1;
	}

	double t0 = now_ms();
	if (send(sock, oscore_buf, oscore_len, 0) < 0) {
		if (!quiet) {
			printf("send failed\n");
		}
		return -1;
	}

	uint8_t buf[MAXLINE];
	int n = recv(sock, buf, sizeof(buf), 0);
	if (n < 0) {
		if (!quiet) {
			printf("  %-14s -> no response\n", uri);
		}
		return -1;
	}
	if (rtt_ms) {
		*rtt_ms = now_ms() - t0;
	}

	uint8_t coap_buf[OSCORE_MAX];
	uint32_t coap_len = sizeof(coap_buf);
	e = oscore2coap(buf, n, coap_buf, &coap_len, osc);
	if (e != ok && e != first_request_after_reboot) {
		if (!quiet) {
			printf("  %-14s -> oscore2coap failed (%d)\n", uri, e);
		}
		return -1;
	}

	CoapPDU rx(coap_buf, coap_len);
	if (!rx.validate()) {
		if (!quiet) {
			printf("  %-14s -> invalid inner CoAP\n", uri);
		}
		return -1;
	}
	if (!quiet) {
		int pl = rx.getPayloadLength();
		printf("  %-14s -> code %d.%02d  \"%.*s\"\n", uri, (rx.getCode() >> 5),
		       (rx.getCode() & 0x1f), pl, (char *)rx.getPayloadPointer());
	}
	return 0;
}

/* Time @count OSCORE-protected round trips of one endpoint (after @warmup
 * untimed ones) over the persistent context, and print min/mean/median/p95/p99/
 * max/sd/loss in the same shape scripts/coap_latency.py uses. */
static void bench_endpoint(int sock, struct context *osc, const char *label,
			   CoapPDU::Code code, const char *uri, const uint8_t *payload,
			   size_t payload_len, int count, int warmup)
{
	std::vector<double> rtts;
	rtts.reserve(count);
	int losses = 0;
	for (int i = 0; i < count + warmup; i++) {
		double rtt = -1.0;
		int r = oscore_request(sock, osc, code, uri, payload, payload_len, &rtt, true);
		if (i < warmup) {
			continue;
		}
		if (r != 0 || rtt < 0.0) {
			losses++;
		} else {
			rtts.push_back(rtt);
		}
	}
	if (rtts.empty()) {
		printf("%-14s no responses (loss=%d)\n", label, losses);
		return;
	}
	std::sort(rtts.begin(), rtts.end());
	size_t n = rtts.size();
	double sum = 0.0;
	for (double v : rtts) {
		sum += v;
	}
	double mean = sum / (double)n;
	double var = 0.0;
	for (double v : rtts) {
		var += (v - mean) * (v - mean);
	}
	double sd = std::sqrt(var / (double)n);
	double med = (n % 2) ? rtts[n / 2] : (rtts[n / 2 - 1] + rtts[n / 2]) / 2.0;
	size_t p95 = (size_t)std::lround(0.95 * (double)(n - 1));
	size_t p99 = (size_t)std::lround(0.99 * (double)(n - 1));
	printf("%-14s n=%-5zu min=%6.3f  mean=%6.3f  med=%6.3f  p95=%6.3f  p99=%6.3f  "
	       "max=%7.3f  sd=%5.3f  loss=%d  (ms)\n",
	       label, n, rtts[0], mean, med, rtts[p95], rtts[p99], rtts[n - 1], sd, losses);
}

/* CBOR encoding of a one-byte connection identifier (RFC 9528 3.3.2). */
static uint8_t cid_to_cbor(int v)
{
	return (v >= 0) ? (uint8_t)v : (uint8_t)(0x20 + (-v) - 1);
}

int main(int argc, char **argv)
{
	/* [host] [--bench] [--count N] [--warmup N]. Without --bench the tool does
	 * the original one-shot demo round-trip; --bench times a latency loop. */
	bool bench = false;
	int count = 1000, warmup = 50;
	for (int i = 1; i < argc; i++) {
		if (strcmp(argv[i], "--bench") == 0) {
			bench = true;
		} else if (strcmp(argv[i], "--count") == 0 && i + 1 < argc) {
			count = atoi(argv[++i]);
		} else if (strcmp(argv[i], "--warmup") == 0 && i + 1 < argc) {
			warmup = atoi(argv[++i]);
		} else if (argv[i][0] != '-') {
			g_host = argv[i];
		}
	}

	if (psa_crypto_init() != PSA_SUCCESS) {
		printf("psa_crypto_init failed\n");
		return 1;
	}

	int sock;
	struct sockaddr_in servaddr;
	if (sock_init(SOCK_CLIENT, g_host, IPv4, &servaddr, sizeof(servaddr), &sock) < 0) {
		printf("socket init failed\n");
		return 1;
	}
	/* Bound recv: X25519 makes the handshake fast, so a short timeout is
	 * plenty and avoids hanging if the device is slow/unreachable. */
	struct timeval tv;
	tv.tv_sec = 5;
	tv.tv_usec = 0;
	setsockopt(sock, SOL_SOCKET, SO_RCVTIMEO, &tv, sizeof(tv));

	printf("EDHOC/OSCORE client -> coap://%s (suite 0 / X25519)\n\n", g_host);

	/* ---- EDHOC handshake (Initiator) ---- */
	struct edhoc_context ctx;
	static const enum edhoc_method methods[] = {EDHOC_METHOD_3};
	static const struct edhoc_credentials creds = {cred_fetch, cred_verify};
	struct edhoc_connection_id cid;
	memset(&cid, 0, sizeof(cid));
	cid.encode_type = EDHOC_CID_TYPE_ONE_BYTE_INTEGER;
	cid.int_value = ED_C_I_INT;

	if (edhoc_context_init(&ctx) != EDHOC_SUCCESS ||
	    edhoc_set_methods(&ctx, methods, 1) != EDHOC_SUCCESS ||
	    edhoc_set_cipher_suites(&ctx, edhoc_cipher_suite_0_get_suite(), 1) != EDHOC_SUCCESS ||
	    edhoc_set_connection_id(&ctx, &cid) != EDHOC_SUCCESS ||
	    edhoc_bind_keys(&ctx, edhoc_cipher_suite_0_get_keys()) != EDHOC_SUCCESS ||
	    edhoc_bind_crypto(&ctx, edhoc_cipher_suite_0_get_crypto()) != EDHOC_SUCCESS ||
	    edhoc_bind_credentials(&ctx, &creds) != EDHOC_SUCCESS) {
		printf("EDHOC setup failed\n");
		return 1;
	}

	uint8_t msg[MSG_MAX];
	uint8_t framed[MSG_MAX + 1];
	uint8_t resp[MSG_MAX];
	size_t msg_len = 0;
	size_t resp_len;
	int ret;

	/* message_1: prefix CBOR true (0xf5), RFC 9668. */
	double t_hs0 = now_ms();
	ret = edhoc_message_1_compose(&ctx, msg, sizeof(msg), &msg_len);
	if (ret != EDHOC_SUCCESS) {
		printf("message_1_compose failed (%d)\n", ret);
		return 1;
	}
	framed[0] = 0xf5;
	memcpy(framed + 1, msg, msg_len);
	resp_len = sizeof(resp);
	if (edhoc_post(sock, framed, msg_len + 1, resp, &resp_len) != 0) {
		return 1;
	}
	ret = edhoc_message_2_process(&ctx, resp, resp_len);
	if (ret != EDHOC_SUCCESS) {
		printf("message_2_process failed (%d)\n", ret);
		return 1;
	}

	/* message_3: prefix the CBOR-encoded C_R (RFC 9668). */
	ret = edhoc_message_3_compose(&ctx, msg, sizeof(msg), &msg_len);
	if (ret != EDHOC_SUCCESS) {
		printf("message_3_compose failed (%d)\n", ret);
		return 1;
	}
	framed[0] = cid_to_cbor(ED_C_R_INT);
	memcpy(framed + 1, msg, msg_len);
	resp_len = sizeof(resp);
	if (edhoc_post(sock, framed, msg_len + 1, resp, &resp_len) != 0) {
		return 1;
	}
	ret = edhoc_message_4_process(&ctx, resp, resp_len);
	if (ret != EDHOC_SUCCESS) {
		printf("message_4_process failed (%d)\n", ret);
		return 1;
	}
	printf("EDHOC handshake complete\n");

	/* ---- Export OSCORE context ---- */
	uint8_t ms[16], salt[8], sid[8], rid[8];
	size_t sid_len = 0, rid_len = 0;
	ret = edhoc_export_oscore_session(&ctx, ms, sizeof(ms), salt, sizeof(salt), sid,
					  sizeof(sid), &sid_len, rid, sizeof(rid), &rid_len);
	if (ret != EDHOC_SUCCESS) {
		printf("export_oscore_session failed (%d)\n", ret);
		return 1;
	}
	edhoc_context_deinit(&ctx);

	/* Initiator OSCORE orientation: Sender ID = C_R, Recipient ID = C_I --
	 * exactly what export returns (positional init flattens into byte_arrays). */
	struct context osc;
	struct oscore_init_params p = {
		{sizeof(ms), ms},
		{(uint32_t)sid_len, sid},
		{(uint32_t)rid_len, rid},
		{0, NULL},
		{sizeof(salt), salt},
		OSCORE_AES_CCM_16_64_128,
		OSCORE_SHA_256,
		true,
	};
	if (oscore_context_init(&p, &osc) != ok) {
		printf("oscore_context_init failed\n");
		return 1;
	}
	double hs_ms = now_ms() - t_hs0;
	printf("OSCORE context ready\n\n");

	if (bench) {
		/* Latency loop: tighten the recv timeout (the handshake is done) and
		 * time the OSCORE-protected round trips, mirroring coap_latency.py. */
		tv.tv_sec = 2;
		tv.tv_usec = 0;
		setsockopt(sock, SOL_SOCKET, SO_RCVTIMEO, &tv, sizeof(tv));

		printf("OSCORE RTT to coap://%s (%d samples, %d warmup)\n", g_host, count, warmup);
		printf("EDHOC+OSCORE handshake: %.3f ms (one-time)\n\n", hs_ms);
		bench_endpoint(sock, &osc, "CON GET /hello", CoapPDU::COAP_GET, "hello", NULL, 0,
			       count, warmup);
		bench_endpoint(sock, &osc, "CON GET /led", CoapPDU::COAP_GET, "led", NULL, 0,
			       count, warmup);
		bench_endpoint(sock, &osc, "CON PUT /led=1", CoapPDU::COAP_PUT, "led",
			       (const uint8_t *)"1", 1, count, warmup);
		close(sock);
		return 0;
	}

	/* ---- OSCORE-protected round-trip (demo) ---- */
	oscore_request(sock, &osc, CoapPDU::COAP_GET, "hello", NULL, 0);
	oscore_request(sock, &osc, CoapPDU::COAP_GET, "led", NULL, 0);
	oscore_request(sock, &osc, CoapPDU::COAP_PUT, "led", (const uint8_t *)"1", 1);
	oscore_request(sock, &osc, CoapPDU::COAP_GET, "led", NULL, 0);
	oscore_request(sock, &osc, CoapPDU::COAP_PUT, "led", (const uint8_t *)"0", 1);

	close(sock);
	return 0;
}
