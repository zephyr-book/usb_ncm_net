## CMakeLists.txt
```
cmake_minimum_required(VERSION 3.20.0)

# The board (zbook/rp2350b/m33) comes from the `zbook` Zephyr module declared in
# west.yml — no BOARD_ROOT here. Select it at build time with `-b zbook/rp2350b/m33`.
find_package(Zephyr REQUIRED HINTS $ENV{ZEPHYR_BASE})
project(usb_ncm_net LANGUAGES C)

include_directories(./include)

file(GLOB_RECURSE SRC ${CMAKE_SOURCE_DIR} "src/*.c")
target_sources(app PRIVATE ${SRC})

# The CoAP service "coap_server" (src/coap_server.c) collects its resources into a
# per-service iterable section named coap_resource_<service>. Register it for both
# linker backends so COAP_SERVICE_DEFINE() finds the list start/end symbols.
zephyr_linker_sources(DATA_SECTIONS sections-ram.ld)
zephyr_iterable_section(
  NAME coap_resource_coap_server
  GROUP DATA_REGION ${XIP_ALIGN_WITH_INPUT})

# EDHOC engine = libedhoc (oscore build only, CONFIG_LIBEDHOC_ENABLE). The
# Zephyr module compiles libedhoc's core + CBOR backend, but the cipher-suite-2
# crypto helper is meant to be compiled by the application (it is not part of the
# module library), so add it here. Both libedhoc (include/) and uoscore-uedhoc
# (inc/) ship a flat edhoc.h on the global include path; prepend libedhoc's dirs
# for the app target so `#include <edhoc.h>` in src/edhoc_oscore.c resolves to
# libedhoc's API rather than uoscore's (which is still linked, for OSCORE only).
if(CONFIG_LIBEDHOC_ENABLE)
  # libedhoc's cipher-suite-2 crypto helper is meant to be app-compiled (it is
  # not part of the Zephyr module library). We compile a vendored+patched copy
  # from vendor/ instead of the module's, because upstream's key agreement uses
  # mbedtls_pk_ec() -- removed in this mbedTLS (tf-psa-crypto 4.x). The legacy
  # ECP API it still needs is exposed via CONFIG_MBEDTLS_DECLARE_PRIVATE_IDENTIFIERS
  # (oscore.conf). See vendor/edhoc_cipher_suite_2.c.
  target_sources(app PRIVATE ${CMAKE_SOURCE_DIR}/vendor/edhoc_cipher_suite_2.c)
  # Prepend libedhoc's public + helper headers so <edhoc.h> in src/edhoc_oscore.c
  # resolves to libedhoc, not uoscore-uedhoc's inc/edhoc.h (still linked for OSCORE).
  target_include_directories(app BEFORE PRIVATE
    ${ZEPHYR_LIBEDHOC_MODULE_DIR}/include
    ${ZEPHYR_LIBEDHOC_MODULE_DIR}/helpers/include)
  # PSA_KEY_HANDLE_INIT was removed from this PSA; the helper still uses it as a
  # null key-id initialiser. Map it to the current spelling.
  target_compile_definitions(app PRIVATE PSA_KEY_HANDLE_INIT=PSA_KEY_ID_NULL)

  # Same flat-edhoc.h clash, other direction: uoscore-uedhoc's own sources
  # #include "edhoc.h" expecting *its* inc/edhoc.h (which defines WEAK etc.), but
  # libedhoc's include/edhoc.h is also on the global include path. Prepend
  # uoscore's inc/ to its module libraries so they resolve to uoscore's header.
  foreach(uoscore_tgt uoscore_uedhoc_common uoscore)
    if(TARGET ${uoscore_tgt})
      target_include_directories(${uoscore_tgt} BEFORE PRIVATE
        ${ZEPHYR_UOSCORE_UEDHOC_MODULE_DIR}/inc)
    endif()
  endforeach()
endif()

# The RP2350 Pico-SDK RNG state lives in an ".uninitialized_data.*" section.
# Zephyr's template places a ".uninitialized_data (NOLOAD)" section in the middle
# of the RAM data region, before usbd_context; once the RNG fills it, that NOLOAD
# gap misaligns the startup .data copy and corrupts usbd_context (USB init fails
# with -EPERM). Claim those inputs into .data (RWDATA, earlier in link order) so
# the gap never forms. See sections-rwdata.ld.
zephyr_linker_sources(RWDATA sections-rwdata.ld)
```

## west.yml
```
manifest:
        remotes:
                - name: zephyrproject
                  url-base: https://github.com/zephyrproject-rtos
                - name: zephyr-book
                  url-base: https://github.com/zephyr-book
                - name: edgebr
                  url-base: https://github.com/edgebr

                # EDHOC (RFC 9528) engine -- replaces uoscore-uedhoc's buggy
                # EDHOC half (see docs/edhoc-oscore-plan.md). uoscore-uedhoc is
                # kept for OSCORE only.
                - name: kamil-kielbasa
                  url-base: https://github.com/kamil-kielbasa

        projects:
                - name: zephyr
                  remote: zephyrproject
                  revision: v4.4.0
                  clone-depth: 1
                  # path-prefix below also prepends to this project's own path,
                  # so `path: zephyr` resolves to deps/zephyr.
                  path: zephyr
                  import:
                          path-prefix: deps/
                          name-allowlist:
                                  - hal_rpi_pico
                                  - cmsis_6
                                  - fatfs
                                  - littlefs
                                  - mbedtls
                                  - tf-psa-crypto
                                  # EDHOC (RFC 9528) + OSCORE (RFC 8613) library
                                  # and its CBOR backend dependency.
                                  - uoscore-uedhoc
                                  - zcbor

                # libedhoc -- EDHOC (RFC 9528) responder engine, pure C, native
                # Zephyr module (ships zephyr/module.yml -> auto-discovered),
                # mbedTLS/PSA backend. Verified byte-exact against RFC 9529 ch.3
                # (our exact method-3/CCS/kid profile). Pinned to a release tag.
                - name: libedhoc
                  remote: kamil-kielbasa
                  revision: v1.14.1
                  path: deps/modules/lib/libedhoc

                # Board support shipped as a Zephyr module (provides boards/ via module.yml).
                - name: zbook
                  remote: zephyr-book
                  revision: main

                - name: oled-mono-fonts
                  remote: edgebr
                  revision: zephyr
                  path: deps/modules/fonts/oled-mono-fonts

                - name: oled-sh1106-zephyr
                  remote: edgebr
                  revision: 3-wire-spi
                  clone-depth: 1
                  path: deps/modules/drivers/display

        self:
                path: usb_ncm_net
```

## prj.conf
```kconfig
# usb_ncm_net -- USB CDC-NCM + CoAP server (minimal, IPv4/UDP-only).
#
# This is the base build: plaintext CoAP, single client, trimmed net stack.
# For the DTLS/CoAPS (X.509) variant, layer dtls.conf on top:
#   west build -p always -b zbook/rp2350b/m33 -- -DEXTRA_CONF_FILE=dtls.conf
#   (or: just build-dtls)
#
# After flashing, reset the board so macOS cleanly re-enumerates the USB device.

# --- USB device stack (device_next) + CDC-NCM ethernet class ---
CONFIG_USB_DEVICE_STACK_NEXT=y
CONFIG_USBD_CDC_NCM_CLASS=y

# --- Net stack: Ethernet L2 (NCM dep) + IPv4 + UDP sockets only ---
# No IPv6, no TCP, no DHCP, no connection manager. The static IPv4 address is set
# directly in main() (net_if_ipv4_addr_add), so there is no net-config layer.
CONFIG_NETWORKING=y
CONFIG_NET_L2_ETHERNET=y
CONFIG_NET_IPV4=y
CONFIG_NET_IPV6=n
CONFIG_NET_TCP=n
CONFIG_NET_UDP=y
CONFIG_NET_SOCKETS=y

# --- Minimal packet/buffer/context pools for one CoAP client over UDP ---
CONFIG_NET_PKT_RX_COUNT=4
CONFIG_NET_PKT_TX_COUNT=4
CONFIG_NET_BUF_RX_COUNT=16
CONFIG_NET_BUF_TX_COUNT=16
CONFIG_NET_MAX_CONTEXTS=1

# --- Drop IPv4/net features unused by unicast CoAP ---
CONFIG_NET_IPV4_IGMP=n
CONFIG_NET_IPV4_HDR_OPTIONS=n
CONFIG_NET_CONTEXT_DSCP_ECN=n
CONFIG_NET_ARP_GRATUITOUS=n

# --- GPIO for the "led" resource ---
CONFIG_GPIO=y

# The board dtsi enables a voltage-divider sensor node we don't use; keep the
# driver off so it doesn't require the SENSOR subsystem.
CONFIG_VOLTAGE_DIVIDER=n

# --- CoAP server (own thread, autostarts UDP :5683). Single client. ---
CONFIG_COAP=y
CONFIG_COAP_SERVER=y
CONFIG_COAP_SERVER_WELL_KNOWN_CORE=n
CONFIG_COAP_SERVER_BLOCK_SIZE=64
CONFIG_COAP_SERVICE_OBSERVERS=0
CONFIG_COAP_SERVICE_PENDING_MESSAGES=1
CONFIG_COAP_SERVER_STACK_SIZE=2048

# --- RP2350 HW RNG for CoAP randomness (see sections-rwdata.ld in CMakeLists.txt) ---
CONFIG_ENTROPY_GENERATOR=y

# --- RP2350 SHA-256 hardware accelerator (Zephyr crypto device API) ---
# Enables the raspberrypi,pico-sha256 driver (CRYPTO_RPI_PICO_SHA256 auto-selects
# once the `sha256` devicetree node is set okay in app.overlay). Only the OSCORE
# build actually uses it -- src/edhoc_oscore.c routes libedhoc's suite-0 transcript
# hash (the one app-replaceable SHA-256) through this device instead of PSA. HKDF,
# HMAC and AES-CCM stay on PSA: the block is hash-only and tf-psa-crypto 1.0 dropped
# the mbedTLS SHA-256 ALT hook, so the PSA path can't be redirected. In the base and
# DTLS builds the driver is built but unused (small flash cost).
CONFIG_CRYPTO=y

# --- Console on UART0 (shell + INFO logging); no net / coap_server shells. ---
# Shell and INFO-level logging are ON for normal use and debugging. For
# latency/throughput measurement, layer perf.conf -- it turns both OFF, since the
# shell and per-request LOG_* calls do synchronous UART I/O that perturbs
# transmission and inflates the measured CoAP round-trip time:
#   west build ... -- -DEXTRA_CONF_FILE=perf.conf          # or "dtls.conf;perf.conf"
CONFIG_SHELL=y
CONFIG_NET_SHELL=n
CONFIG_COAP_SERVER_SHELL=n
CONFIG_LOG=y

CONFIG_MAIN_STACK_SIZE=2048
```

## dtls.conf
```kconfig
# usb_ncm_net -- DTLS / CoAPS (PSK) variant. Layer on top of prj.conf:
#   west build -p always -b zbook/rp2350b/m33 \
#       -- -DEXTRA_CONF_FILE=dtls.conf -DMBEDTLS_FATAL_WARNINGS=OFF
#   (or: just build-dtls)
#
# Turns the plaintext CoAP server (UDP :5683) into a CoAPS server (DTLS 1.2 over
# UDP :5684) authenticated with a pre-shared key (TLS_PSK_WITH_AES_128_CCM_8 --
# CoAP's RFC 7252 mandatory-to-implement mode). PSK is far smaller and faster than
# X.509: no certificate parsing, no ECDSA/ECDHE, symmetric-only handshake.
# src/coap_server.c switches to COAPS_SERVICE_DEFINE and registers the PSK when
# CONFIG_NET_SOCKETS_ENABLE_DTLS is set.

# --- Secure sockets / DTLS ---
CONFIG_NET_SOCKETS_SOCKOPT_TLS=y
CONFIG_NET_SOCKETS_ENABLE_DTLS=y
# Headroom for a few concurrent/lingering DTLS sessions: short-lived clients
# (e.g. scripts/coap_cli.py, one handshake + request per run) can leave a session
# briefly held on the server before it ages out, so keep more than one context
# free to avoid a new handshake getting no response.
CONFIG_NET_SOCKETS_TLS_MAX_CONTEXTS=4
CONFIG_NET_SOCKETS_DTLS_TIMEOUT=30000

# --- mbedTLS, PSK-only ---
CONFIG_MBEDTLS=y
CONFIG_MBEDTLS_ENABLE_HEAP=y
CONFIG_MBEDTLS_HEAP_SIZE=16384
CONFIG_MBEDTLS_SSL_MAX_CONTENT_LEN=1024

# TLS_PSK_WITH_AES_128_CCM_8: no convenience ciphersuite symbol exists for CCM-8,
# so select the same deps the PSK-GCM ciphersuite does, with CCM instead of GCM.
CONFIG_MBEDTLS_SSL_PROTO_TLS1_2=y
CONFIG_MBEDTLS_KEY_EXCHANGE_PSK_ENABLED=y
CONFIG_PSA_WANT_ALG_CCM=y
CONFIG_PSA_WANT_ALG_SHA_256=y
CONFIG_PSA_WANT_ALG_HMAC=y
CONFIG_PSA_WANT_ALG_TLS12_PRF=y
CONFIG_PSA_WANT_ALG_TLS12_PSK_TO_MS=y
CONFIG_PSA_WANT_KEY_TYPE_AES=y
CONFIG_PSA_WANT_KEY_TYPE_DERIVE=y

# --- Modest pool/stack bumps for DTLS records + handshake (PSK is light) ---
CONFIG_NET_PKT_RX_COUNT=6
CONFIG_NET_PKT_TX_COUNT=6
CONFIG_NET_BUF_RX_COUNT=24
CONFIG_NET_BUF_TX_COUNT=24
CONFIG_NET_MAX_CONTEXTS=3
CONFIG_COAP_SERVER_STACK_SIZE=4096
```

## minimal.conf
```kconfig
# usb_ncm_net -- minimal NETWORKING-STACK profile.
#
# Layer on top of prj.conf:
#   west build -p always -b zbook/rp2350b/m33 -d build-min -- -DEXTRA_CONF_FILE=minimal.conf
#   (or: just build-min)
#
# This trims ONLY the networking stack (packet/buffer pools, network contexts,
# CoAP parameters) so its footprint can be compared against prj.conf with
# everything else -- shell, logging, diagnostics, stacks -- held identical.
# Assumes a single CoAP client over UDP (no concurrent consumers).

# --- Packet/buffer pools sized for one small CoAP flow ---
CONFIG_NET_PKT_RX_COUNT=4
CONFIG_NET_PKT_TX_COUNT=4
CONFIG_NET_BUF_RX_COUNT=16
CONFIG_NET_BUF_TX_COUNT=16

# --- One UDP socket (the CoAP server) -> one network context ---
CONFIG_NET_MAX_CONTEXTS=1

# --- CoAP: one client, no observe, no .well-known/core discovery, tiny payloads ---
CONFIG_COAP_SERVER_WELL_KNOWN_CORE=n
CONFIG_COAP_SERVER_BLOCK_SIZE=64
CONFIG_COAP_SERVICE_OBSERVERS=0
CONFIG_COAP_SERVICE_PENDING_MESSAGES=1
CONFIG_COAP_SERVER_STACK_SIZE=2048

# --- Drop the diagnostic shells ---
# The `net` shell (~14 KB flash of net iface/stats/ping) also force-selects
# NET_IPV4_IGMP (which pulls NET_IPV4_HDR_OPTIONS), so dropping it is what lets
# those be disabled below. The `coap_server` shell is dropped too. The general
# shell backend (CONFIG_SHELL) is left on for a bare console.
CONFIG_NET_SHELL=n
CONFIG_COAP_SERVER_SHELL=n

# --- Drop IPv4/net features unused by unicast CoAP (flash trim) ---
# Multicast group mgmt, IP header-option parsing, QoS/DSCP marking and
# gratuitous-ARP announce are not needed on a static point-to-point unicast
# link. (Fragmentation, PMTU, ACD, promiscuous and the NET_CONTEXT_* socket
# options are already off by not being enabled.)
CONFIG_NET_IPV4_IGMP=n
CONFIG_NET_IPV4_HDR_OPTIONS=n
CONFIG_NET_CONTEXT_DSCP_ECN=n
CONFIG_NET_ARP_GRATUITOUS=n
```

## oscore.conf
```kconfig
# usb_ncm_net -- EDHOC + OSCORE variant. Layer on top of prj.conf:
#   west build -p always -b zbook/rp2350b/m33 -- -DEXTRA_CONF_FILE=oscore.conf
#   (or: just build-oscore)
#
# Application-layer security over PLAIN CoAP/UDP :5683 (no DTLS):
#   - EDHOC (RFC 9528, method 3 static-DH, suite 0 X25519) establishes keys via
#     POSTs to /.well-known/edhoc (RFC 9668 transport binding).
#   - OSCORE (RFC 8613) protects the hello/led exchange.
# The peer (EDHOC Initiator + OSCORE client) is the host PC -- a TypeScript
# client using node-edhoc + node-coap-oscore (native bindings to the same
# libedhoc + uoscore-uedhoc this device runs). See scripts/ts-client/.
#
# Split-library design (see docs/edhoc-oscore-plan.md):
#   - EDHOC engine = libedhoc (RFC-9528-final, RFC-9529 byte-verified).
#     src/edhoc_oscore.c is compiled in when CONFIG_LIBEDHOC_ENABLE is set.
#   - OSCORE engine = uoscore-uedhoc's OSCORE half (kept; its EDHOC half has two
#     unfixed RFC-9528 encoding bugs and is no longer built -- CONFIG_UEDHOC off).
#
# SSN persistence is NOT enabled: a fresh EDHOC run each boot re-keys OSCORE, so
# the sender sequence number always starts from 0 (no AEAD nonce reuse).

# --- EDHOC engine: libedhoc (native Zephyr module) ---
CONFIG_LIBEDHOC_ENABLE=y
# Tune the compile-time working-set to our single profile (method 3, suite 0,
# one-byte connection ids and kids, no EAD). Smaller than the defaults.
CONFIG_LIBEDHOC_MAX_NR_OF_CIPHER_SUITES=1
CONFIG_LIBEDHOC_MAX_LEN_OF_CONN_ID=1
CONFIG_LIBEDHOC_MAX_LEN_OF_ECC_KEY=32
CONFIG_LIBEDHOC_MAX_LEN_OF_MAC=32
CONFIG_LIBEDHOC_MAX_NR_OF_EAD_TOKENS=0
CONFIG_LIBEDHOC_MAX_LEN_OF_CRED_KEY_ID=1
# Working buffers on the (CoAP server) thread stack via C99 VLAs -- no heap.
CONFIG_LIBEDHOC_MEM_BACKEND_STACK=y
# Route libedhoc's diagnostics through Zephyr logging during bring-up.
CONFIG_LIBEDHOC_LOG_LEVEL_WRN=y

# --- OSCORE engine: uoscore-uedhoc (OSCORE only; EDHOC half disabled) ---
# UOSCORE `depends on ZCBOR && ZCBOR_CANONICAL` and `select`s a set of PSA crypto
# primitives (incl. AES-CCM, HMAC, SHA-256; the P-256/ECC selects are unused here).
# CONFIG_UEDHOC is intentionally NOT set -- libedhoc replaces it.
CONFIG_UOSCORE=y
CONFIG_ZCBOR=y
CONFIG_ZCBOR_CANONICAL=y

# --- Crypto backend: mbedTLS PSA (already in the manifest) ---
# OSCORE and libedhoc's suite-0 AEAD/HKDF/hash run through the PSA API (heap-
# backed, as in the DTLS variant). X25519 does NOT go through PSA/mbedTLS:
# libedhoc's suite-0 helper does the scalar multiplication with the compact25519
# library (compiled by the app -- see CMakeLists.txt), so there is no mbedTLS
# ECP / bignum / point decompression and none of the "private legacy
# identifiers" plumbing that the suite-2 / P-256 path required.
CONFIG_MBEDTLS=y
CONFIG_MBEDTLS_ENABLE_HEAP=y
CONFIG_MBEDTLS_HEAP_SIZE=16384

# HKDF is not in uoscore's PSA-common select set, but libedhoc's suite-0 helper
# derives PRK_2e/PRK_out via psa_key_derivation with PSA_ALG_HKDF_EXTRACT /
# _EXPAND (SHA-256), so enable them explicitly.
CONFIG_PSA_WANT_ALG_HKDF_EXTRACT=y
CONFIG_PSA_WANT_ALG_HKDF_EXPAND=y

# --- Stack / buffer sizing ---
# The whole EDHOC handshake runs synchronously on the CoAP server thread
# (edhoc_post drives libedhoc directly -- no dedicated responder thread), and the
# OSCORE encrypt/decrypt runs there too. 8192 covered the heavier suite-2 P-256
# handshake (measured high-water 6296 B via `kernel thread stacks`); X25519 uses
# less, so this keeps ample headroom (re-measure and trim if desired).
CONFIG_COAP_SERVER_STACK_SIZE=8192
# main() only does PSA/USB/net init (the handshake is on the CoAP thread), so the
# default suffices -- same as the DTLS variant, whose main does heavier X.509 work.
CONFIG_MAIN_STACK_SIZE=2048
# One client, strictly sequential, so the base plaintext pool sizes are enough --
# no need for the DTLS variant's larger pools (DTLS fragments records + session state).
CONFIG_NET_PKT_RX_COUNT=4
CONFIG_NET_PKT_TX_COUNT=4
CONFIG_NET_BUF_RX_COUNT=16
CONFIG_NET_BUF_TX_COUNT=16
CONFIG_NET_MAX_CONTEXTS=2

# The CoAP server rejects any inbound datagram larger than MESSAGE_SIZE with
# 4.13 Request Too Large. It defaults to COAP_SERVER_BLOCK_SIZE (64 in prj.conf),
# which is too small for the EDHOC message POSTs (message_1 carries a 32-byte G_X
# plus CoAP header/token/Uri-Path framing, ~65 B). Size it to our message buffer.
CONFIG_COAP_SERVER_MESSAGE_SIZE=256

# --- Logging: keep INFO on (base prj.conf already enables it); compile out for
# latency runs via perf.conf. ---
CONFIG_LOG=y
```

## perf.conf
```kconfig
# usb_ncm_net -- performance-measurement overlay.
#
# Layer on top of prj.conf (and optionally dtls.conf) for CoAP latency/throughput
# runs with scripts/coap_latency.py:
#   west build -p always -b zbook/rp2350b/m33 -d build-perf \
#         -- -DEXTRA_CONF_FILE=perf.conf                              # plaintext
#   west build -p always -b zbook/rp2350b/m33 -d build-dtls-perf \
#         -- -DEXTRA_CONF_FILE="dtls.conf;perf.conf" -DMBEDTLS_FATAL_WARNINGS=OFF
#   (or: just build-perf / just build-dtls-perf)
#
# The shell and the logging subsystem both do synchronous UART I/O that perturbs
# transmission and inflates the measured round-trip latency, so both are compiled
# out here. Everything else (net stack, CoAP server, resources) is unchanged.
CONFIG_SHELL=n
CONFIG_LOG=n
```

## app.overlay
```dts
/*
 * Copyright (c) 2026 Centro de Inovacao EDGE
 * SPDX-License-Identifier: Apache-2.0
 *
 * USB CDC-NCM virtual Ethernet link between the ZBook board and a host.
 *
 * The RP2350 native USB device controller is left disabled by the board, so we
 * enable it here and attach a CDC-NCM ethernet function. The board then shows up
 * on the host as a USB Ethernet adapter; a CoAP server runs over it (see
 * src/coap_server.c). Host IP is configured manually (board = 192.0.2.1).
 */

#include <zephyr/dt-bindings/gpio/gpio.h>

/ {
	/*
	 * Virtual Ethernet endpoint exposed over USB CDC-NCM. remote-mac is the
	 * host (macOS) end of the link; it must differ from the board's local MAC
	 * (which is auto-assigned).
	 */
	cdc_ncm_eth0: cdc_ncm_eth0 {
		compatible = "zephyr,cdc-ncm-ethernet";
		remote-mac-address = "00005E005301";
	};
};

/* RP2350 native USB device controller (disabled by the board by default). */
zephyr_udc0: &usbd {
	status = "okay";
};

/*
 * RP2350 SHA-256 hardware accelerator, left disabled by the SoC dtsi. Enable it so
 * the Zephyr crypto driver (raspberrypi,pico-sha256) binds. The OSCORE build routes
 * EDHOC's transcript hash through it (see src/edhoc_oscore.c); the base/DTLS builds
 * carry the driver but never call it.
 */
&sha256 {
	status = "okay";
};
```

## src/main.c
```c
/**
 * @file main.c
 * @brief USB-NCM networking bring-up.
 *
 * Brings the RP2350 native USB device controller up as a CDC-NCM virtual
 * Ethernet adapter and assigns a static IPv4 address to it directly -- no DHCP,
 * no connection-manager, no net-config layer. The CoAP server
 * (src/coap_server.c) autostarts on its own thread, so main() only enables USB,
 * sets the address, and returns. The host configures its end (192.0.2.2) by
 * hand. See README.md.
 *
 * @copyright Copyright (c) 2026 Centro de Inovacao EDGE
 * SPDX-License-Identifier: Apache-2.0
 */

#include "coap_server.h"
#include "usbd_setup.h"

#include <zephyr/kernel.h>
#include <zephyr/logging/log.h>
#include <zephyr/net/net_if.h>
#include <zephyr/net/net_ip.h>
#include <zephyr/usb/usbd.h>
#if defined(CONFIG_LIBEDHOC_ENABLE)
#include <psa/crypto.h>
#endif

LOG_MODULE_REGISTER(usb_ncm_net, LOG_LEVEL_INF);

/* Static IPv4 on the NCM interface. The host uses 192.0.2.2 (configured by hand). */
#define BOARD_IPV4_ADDR    "192.0.2.1"
#define BOARD_IPV4_NETMASK "255.255.255.0"

static void usbd_msg_cb(struct usbd_context *const ctx, const struct usbd_msg *const msg)
{
	if (!usbd_can_detect_vbus(ctx)) {
		return;
	}

	if (msg->type == USBD_MSG_VBUS_READY) {
		if (usbd_enable(ctx)) {
			LOG_ERR("Failed to enable device support");
		}
	} else if (msg->type == USBD_MSG_VBUS_REMOVED) {
		if (usbd_disable(ctx)) {
			LOG_ERR("Failed to disable device support");
		}
	}
}

/* Assign the static IPv4 address directly -- no DHCP, no net_config layer. */
static int assign_static_ipv4(void)
{
	struct net_if *iface = net_if_get_default();
	struct net_in_addr addr;
	struct net_in_addr netmask;

	if (iface == NULL) {
		LOG_ERR("No default network interface");
		return -ENODEV;
	}

	if (net_addr_pton(NET_AF_INET, BOARD_IPV4_ADDR, &addr) < 0 ||
	    net_addr_pton(NET_AF_INET, BOARD_IPV4_NETMASK, &netmask) < 0) {
		return -EINVAL;
	}

	if (net_if_ipv4_addr_add(iface, &addr, NET_ADDR_MANUAL, 0) == NULL) {
		LOG_ERR("Failed to add IPv4 address");
		return -EADDRNOTAVAIL;
	}

	(void)net_if_ipv4_set_netmask_by_addr(iface, &addr, &netmask);

	return 0;
}

int main(void)
{
	struct usbd_context *ctx;

	ctx = ncm_usbd_init(usbd_msg_cb);
	if (ctx == NULL) {
		LOG_ERR("Failed to initialize USB device");
		return 0;
	}

	/* Controllers without VBUS detection must be enabled here; those with it
	 * are enabled from usbd_msg_cb() on USBD_MSG_VBUS_READY.
	 */
	if (!usbd_can_detect_vbus(ctx)) {
		if (usbd_enable(ctx)) {
			LOG_ERR("Failed to enable USB device support");
			return 0;
		}
	}

	(void)assign_static_ipv4();

#if defined(CONFIG_LIBEDHOC_ENABLE)
	/* libedhoc (EDHOC) and uoscore (OSCORE) drive mbedTLS through the PSA
	 * API, which must be initialised explicitly (the DTLS variant relies on
	 * Zephyr's automatic init instead). Safe to call once here before any
	 * crypto runs.
	 */
	{
		psa_status_t st = psa_crypto_init();

		if (st != PSA_SUCCESS) {
			LOG_ERR("psa_crypto_init failed (%d)", (int)st);
		} else {
			LOG_INF("PSA crypto initialised");
		}
	}
#endif

	/* Plaintext CoAP autostarts; the DTLS variant registers X.509 creds and
	 * starts CoAPS here (after the interface exists).
	 */
	(void)coap_server_start();

	LOG_INF("USB-NCM up (board " BOARD_IPV4_ADDR ")");
	return 0;
}
```

## include/coap_server.h
```c
/**
 * @file coap_server.h
 * @brief CoAP server startup hook.
 *
 * @copyright Copyright (c) 2026 Centro de Inovacao EDGE
 * SPDX-License-Identifier: Apache-2.0
 */

#ifndef USB_NCM_NET_COAP_SERVER_H
#define USB_NCM_NET_COAP_SERVER_H

#include <zephyr/net/coap.h>

/**
 * @brief Bring the CoAP server up.
 *
 * Plaintext build: the service is autostarted by the CoAP server thread, so
 * this only logs. DTLS build (CONFIG_NET_SOCKETS_ENABLE_DTLS): registers the
 * X.509 server credentials and starts the CoAPS service on UDP 5684.
 *
 * @return 0 on success, negative errno on failure.
 */
int coap_server_start(void);

/**
 * @brief Route a parsed CoAP request to an app resource and build its response.
 *
 * Dispatches @p request to the "hello"/"led" resources and writes the CoAP
 * response into @p response (backed by @p buf / @p buf_len). Shared by the
 * plaintext COAP_SERVICE handlers and by the OSCORE intercept
 * (src/edhoc_oscore.c), which dispatches the decrypted inner request.
 *
 * @return 0 on success, negative errno on failure.
 */
int coap_server_dispatch_inner(struct coap_packet *request, uint8_t *buf, uint16_t buf_len,
			       struct coap_packet *response);

#endif /* USB_NCM_NET_COAP_SERVER_H */
```

## include/usbd_setup.h
```c
/**
 * @file usbd_setup.h
 * @brief Minimal USB device (device_next) context for the CDC-NCM ethernet link.
 *
 * @copyright Copyright (c) 2026 Centro de Inovacao EDGE
 * SPDX-License-Identifier: Apache-2.0
 */

#ifndef USB_NCM_NET_USBD_SETUP_H
#define USB_NCM_NET_USBD_SETUP_H

#include <zephyr/usb/usbd.h>

/**
 * @brief Build and initialize the USB device context (CDC-NCM class).
 *
 * Registers the string/configuration descriptors and all enabled USB classes
 * (including the CDC-NCM ethernet function declared in the devicetree), then
 * calls usbd_init(). The caller is responsible for usbd_enable().
 *
 * @param msg_cb USBD message callback (VBUS / class events), or NULL to skip
 *               registration.
 * @return Pointer to the initialized context, or NULL on failure.
 */
struct usbd_context *ncm_usbd_init(usbd_msg_cb_t msg_cb);

#endif /* USB_NCM_NET_USBD_SETUP_H */
```

## src/coap_server.c
```c
/**
 * @file coap_server.c
 * @brief Minimal CoAP server exposed over the USB-NCM link.
 *
 * Declares a CoAP service that autostarts its own UDP server on port 5683 with:
 *   - "hello" : GET, returns a greeting string.
 *   - "led"   : GET returns the board LED state ("0"/"1"); PUT "0"/"1" (or
 *               "off"/"on") sets it. Drives the led0 alias (blue LED).
 * The stack provides .well-known/core discovery (CONFIG_COAP_SERVER_WELL_KNOWN_CORE).
 * The service binds to the IPv4 wildcard, so it answers on the board's NCM IPv4
 * address (192.0.2.1).
 *
 * Modeled on samples/net/sockets/coap_server/src/core.c.
 *
 * @copyright Copyright (c) 2026 Centro de Inovacao EDGE
 * SPDX-License-Identifier: Apache-2.0
 */

#include "coap_server.h"

#include <string.h>

#include <zephyr/device.h>
#include <zephyr/drivers/gpio.h>
#include <zephyr/init.h>
#include <zephyr/logging/log.h>
#include <zephyr/net/coap.h>
#include <zephyr/net/coap_service.h>
#if defined(CONFIG_NET_SOCKETS_ENABLE_DTLS)
#include <zephyr/net/tls_credentials.h>
#endif

LOG_MODULE_REGISTER(coap_server, LOG_LEVEL_INF);

#if defined(CONFIG_NET_SOCKETS_ENABLE_DTLS)
/* CoAPS (secure) UDP port. */
static uint16_t coap_port = 5684;
#else
/* Standard CoAP UDP port. */
static uint16_t coap_port = 5683;
#endif

/*
 * Response builders. Each fills @p response (backed by @p buf) for one resource
 * without transmitting it, so the same logic serves both the plaintext
 * COAP_SERVICE handlers below and the OSCORE intercept (src/edhoc_oscore.c),
 * which encrypts the built response before sending.
 */

static int build_hello(struct coap_packet *response, uint8_t *buf, uint16_t buf_len,
			uint8_t tkl, const uint8_t *token, uint16_t id)
{
	static const char payload[] = "Hello from ZBook over USB-NCM\n";
	int r;

	LOG_INF("GET /hello");

	r = coap_packet_init(response, buf, buf_len, COAP_VERSION_1, COAP_TYPE_ACK, tkl, token,
			     COAP_RESPONSE_CODE_CONTENT, id);
	if (r < 0) {
		return r;
	}

	r = coap_packet_append_payload_marker(response);
	if (r < 0) {
		return r;
	}

	return coap_packet_append_payload(response, (const uint8_t *)payload, strlen(payload));
}

/* Board LED behind the "led" resource (led0 alias = blue LED, active-low). */
static const struct gpio_dt_spec led_gpio = GPIO_DT_SPEC_GET(DT_ALIAS(led0), gpios);
static bool led_state;

static int led_init(void)
{
	if (!gpio_is_ready_dt(&led_gpio)) {
		LOG_ERR("LED %s not ready", led_gpio.port ? led_gpio.port->name : "(none)");
		return -ENODEV;
	}

	return gpio_pin_configure_dt(&led_gpio, GPIO_OUTPUT_INACTIVE);
}
SYS_INIT(led_init, APPLICATION, CONFIG_APPLICATION_INIT_PRIORITY);

/** Parse an on/off request payload: "1"/"on" -> 1, "0"/"off" -> 0, else -1. */
static int parse_onoff(const uint8_t *payload, uint16_t len)
{
	if (len >= 1 && payload[0] == '1') {
		return 1;
	}
	if (len >= 1 && payload[0] == '0') {
		return 0;
	}
	if (len >= 2 && strncmp((const char *)payload, "on", 2) == 0) {
		return 1;
	}
	if (len >= 3 && strncmp((const char *)payload, "off", 3) == 0) {
		return 0;
	}

	return -1;
}

static int build_led_get(struct coap_packet *response, uint8_t *buf, uint16_t buf_len,
			 uint8_t tkl, const uint8_t *token, uint16_t id)
{
	const uint8_t value = led_state ? '1' : '0';
	int r;

	LOG_INF("GET /led -> %c", value);

	r = coap_packet_init(response, buf, buf_len, COAP_VERSION_1, COAP_TYPE_ACK, tkl, token,
			     COAP_RESPONSE_CODE_CONTENT, id);
	if (r < 0) {
		return r;
	}

	r = coap_packet_append_payload_marker(response);
	if (r < 0) {
		return r;
	}

	return coap_packet_append_payload(response, &value, sizeof(value));
}

static int build_led_put(struct coap_packet *request, struct coap_packet *response, uint8_t *buf,
			 uint16_t buf_len, uint8_t tkl, const uint8_t *token, uint16_t id)
{
	const uint8_t *payload;
	uint16_t payload_len;
	uint8_t code;
	int value;

	payload = coap_packet_get_payload(request, &payload_len);
	value = (payload != NULL) ? parse_onoff(payload, payload_len) : -1;

	if (value < 0) {
		LOG_WRN("PUT /led: bad payload");
		code = COAP_RESPONSE_CODE_BAD_REQUEST;
	} else {
		(void)gpio_pin_set_dt(&led_gpio, value);
		led_state = value;
		LOG_INF("PUT /led -> %d", value);
		code = COAP_RESPONSE_CODE_CHANGED;
	}

	return coap_packet_init(response, buf, buf_len, COAP_VERSION_1, COAP_TYPE_ACK, tkl, token,
				code, id);
}

static const char *const hello_path[] = {"hello", NULL};
static const char *const led_path[] = {"led", NULL};

int coap_server_dispatch_inner(struct coap_packet *request, uint8_t *buf, uint16_t buf_len,
			       struct coap_packet *response)
{
	struct coap_option options[2];
	uint8_t token[COAP_TOKEN_MAX_LEN];
	uint16_t id = coap_header_get_id(request);
	uint8_t tkl = coap_header_get_token(request, token);
	uint8_t code = coap_header_get_code(request);
	int opt_num = coap_find_options(request, COAP_OPTION_URI_PATH, options, ARRAY_SIZE(options));

	if (opt_num < 0) {
		opt_num = 0;
	}

	if (code == COAP_METHOD_GET && coap_uri_path_match(hello_path, options, opt_num)) {
		return build_hello(response, buf, buf_len, tkl, token, id);
	}

	if (coap_uri_path_match(led_path, options, opt_num)) {
		if (code == COAP_METHOD_GET) {
			return build_led_get(response, buf, buf_len, tkl, token, id);
		}
		if (code == COAP_METHOD_PUT) {
			return build_led_put(request, response, buf, buf_len, tkl, token, id);
		}
	}

	LOG_WRN("unhandled request (code %u)", code);
	return coap_packet_init(response, buf, buf_len, COAP_VERSION_1, COAP_TYPE_ACK, tkl, token,
				COAP_RESPONSE_CODE_NOT_FOUND, id);
}

/*
 * Thin COAP_SERVICE handler used by the plaintext hello/led resources: dispatch
 * to the shared builder, then transmit. (In the OSCORE build these resources
 * stay reachable in the clear during bring-up.)
 */
static int app_request(struct coap_resource *resource, struct coap_packet *request,
		       struct net_sockaddr *addr, net_socklen_t addr_len)
{
	uint8_t data[CONFIG_COAP_SERVER_MESSAGE_SIZE];
	struct coap_packet response;
	int r = coap_server_dispatch_inner(request, data, sizeof(data), &response);

	if (r < 0) {
		return r;
	}

	return coap_resource_send(resource, &response, addr, addr_len, NULL);
}

COAP_RESOURCE_DEFINE(hello, coap_server, {
	.get = app_request,
	.path = hello_path,
});

COAP_RESOURCE_DEFINE(led, coap_server, {
	.get = app_request,
	.put = app_request,
	.path = led_path,
});

#if defined(CONFIG_NET_SOCKETS_ENABLE_DTLS)

/*
 * Pre-shared key + identity (TLS_PSK_WITH_AES_128_CCM_8). DEV credentials --
 * replace and provision out-of-band before shipping. The client must use the
 * same identity + key (see scripts/coap_latency.py).
 */
#define PSK_TAG 1

static const uint8_t psk_key[] = {
	'z', 'b', 'o', 'o', 'k', '-', 'd', 't',
	'l', 's', '-', 'p', 's', 'k', '!', '!',
}; /* 16-byte (128-bit) DEV key */
static const char psk_id[] = "zbook";
static const sec_tag_t sec_tags[] = {PSK_TAG};

/*
 * CoAPS is NOT autostarted: the credentials must be registered before the
 * socket is created, so coap_server_start() adds them and then starts the
 * service. Bind the IPv4 wildcard (host "0.0.0.0").
 */
/* Last arg is the sec-tag list size in BYTES (sizeof), not the element count. */
COAPS_SERVICE_DEFINE(coap_server, "0.0.0.0", &coap_port, 0, sec_tags, sizeof(sec_tags));

int coap_server_start(void)
{
	int err;

	err = tls_credential_add(PSK_TAG, TLS_CREDENTIAL_PSK, psk_key, sizeof(psk_key));
	if (err) {
		LOG_ERR("Failed to add PSK (%d)", err);
		return err;
	}

	err = tls_credential_add(PSK_TAG, TLS_CREDENTIAL_PSK_ID, psk_id, sizeof(psk_id) - 1);
	if (err) {
		LOG_ERR("Failed to add PSK identity (%d)", err);
		return err;
	}

	err = coap_service_start(&coap_server);
	if (err) {
		LOG_ERR("Failed to start CoAPS service (%d)", err);
		return err;
	}

	LOG_INF("CoAPS server on UDP %u (DTLS, PSK AES-128-CCM-8)", coap_port);
	return 0;
}

#else /* plaintext CoAP */

/*
 * Bind the IPv4 wildcard ("0.0.0.0") so unicast CoAP stays reachable at
 * 192.0.2.1. The plaintext service autostarts on the CoAP server thread.
 */
COAP_SERVICE_DEFINE(coap_server, "0.0.0.0", &coap_port, COAP_SERVICE_AUTOSTART);

int coap_server_start(void)
{
	LOG_INF("CoAP server on UDP %u", coap_port);
	return 0;
}

#endif /* CONFIG_NET_SOCKETS_ENABLE_DTLS */
```

## src/usbd_setup.c
```c
/**
 * @file usbd_setup.c
 * @brief Minimal USB device (device_next) context for the CDC-NCM ethernet link.
 *
 * Distilled from samples/subsys/usb/common/sample_usbd_init.c: a single
 * full-speed configuration exposing the CDC-NCM class, with literal VID/PID and
 * string descriptors instead of the sample's Kconfig knobs. The NCM ethernet
 * function is instantiated from the devicetree node (compatible
 * "zephyr,cdc-ncm-ethernet") and picked up by usbd_register_all_classes().
 *
 * @copyright Copyright (c) 2026 Centro de Inovacao EDGE
 * SPDX-License-Identifier: Apache-2.0
 */

#include "usbd_setup.h"

#include <zephyr/device.h>
#include <zephyr/logging/log.h>
#include <zephyr/usb/usbd.h>

LOG_MODULE_REGISTER(usbd_setup, LOG_LEVEL_INF);

/*
 * Zephyr project test VID/PID. Fine for a local bench tool; obtain a real
 * VID/PID before distributing hardware.
 */
#define NCM_USBD_VID 0x2fe3
#define NCM_USBD_PID 0x0001

/* Bus-powered, no remote wakeup. */
#define NCM_USBD_ATTRIBUTES 0
/* Reported max draw, in 2 mA units (250 mA). */
#define NCM_USBD_MAX_POWER  125

USBD_DEVICE_DEFINE(ncm_usbd, DEVICE_DT_GET(DT_NODELABEL(usbd)), NCM_USBD_VID, NCM_USBD_PID);

USBD_DESC_LANG_DEFINE(ncm_lang);
USBD_DESC_MANUFACTURER_DEFINE(ncm_mfr, "Centro de Inovacao EDGE");
USBD_DESC_PRODUCT_DEFINE(ncm_product, "ZBook USB-NCM CoAP");
IF_ENABLED(CONFIG_HWINFO, (USBD_DESC_SERIAL_NUMBER_DEFINE(ncm_sn)));

USBD_DESC_CONFIG_DEFINE(ncm_fs_cfg_desc, "FS Configuration");

USBD_CONFIGURATION_DEFINE(ncm_fs_config, NCM_USBD_ATTRIBUTES, NCM_USBD_MAX_POWER, &ncm_fs_cfg_desc);

struct usbd_context *ncm_usbd_init(usbd_msg_cb_t msg_cb)
{
	int err;

	err = usbd_add_descriptor(&ncm_usbd, &ncm_lang);
	if (err) {
		LOG_ERR("Failed to add language descriptor (%d)", err);
		return NULL;
	}

	err = usbd_add_descriptor(&ncm_usbd, &ncm_mfr);
	if (err) {
		LOG_ERR("Failed to add manufacturer descriptor (%d)", err);
		return NULL;
	}

	err = usbd_add_descriptor(&ncm_usbd, &ncm_product);
	if (err) {
		LOG_ERR("Failed to add product descriptor (%d)", err);
		return NULL;
	}

	IF_ENABLED(CONFIG_HWINFO, (err = usbd_add_descriptor(&ncm_usbd, &ncm_sn);))
	if (err) {
		LOG_ERR("Failed to add serial number descriptor (%d)", err);
		return NULL;
	}

	err = usbd_add_configuration(&ncm_usbd, USBD_SPEED_FS, &ncm_fs_config);
	if (err) {
		LOG_ERR("Failed to add Full-Speed configuration (%d)", err);
		return NULL;
	}

	err = usbd_register_all_classes(&ncm_usbd, USBD_SPEED_FS, 1, NULL);
	if (err) {
		LOG_ERR("Failed to register classes (%d)", err);
		return NULL;
	}

	/* CDC-NCM owns an Interface Association Descriptor: use the IAD triple. */
	usbd_device_set_code_triple(&ncm_usbd, USBD_SPEED_FS, USB_BCC_MISCELLANEOUS, 0x02, 0x01);

	if (msg_cb != NULL) {
		err = usbd_msg_register_cb(&ncm_usbd, msg_cb);
		if (err) {
			LOG_ERR("Failed to register message callback (%d)", err);
			return NULL;
		}
	}

	err = usbd_init(&ncm_usbd);
	if (err) {
		LOG_ERR("Failed to initialize device support (%d)", err);
		return NULL;
	}

	return &ncm_usbd;
}
```
